## firmware/esp32_gateway/components/gateway_config/Kconfig
```kconfig
menu "Gateway Configuration"

    config GATEWAY_UPGRADE_UART_NUM
        int "STM32 upgrade UART controller"
        range 1 2
        default 1
        help
            UART0 is intentionally reserved for the ESP32 console. Select
            UART1 or UART2 for the STM32 binary upgrade protocol.

    config GATEWAY_UPGRADE_UART_TX_GPIO
        int "STM32 upgrade UART TX GPIO (-1 disables UART)"
        range -1 48
        default 17
        help
            The current ESP32-S3-WROOM-1-N16R8 development board exposes
            GPIO17 as a free pin. Connect it to STM32 USART1 RX (PA10).

    config GATEWAY_UPGRADE_UART_RX_GPIO
        int "STM32 upgrade UART RX GPIO (-1 disables UART)"
        range -1 48
        default 18
        help
            The current ESP32-S3-WROOM-1-N16R8 development board exposes
            GPIO18 as a free pin. Connect it to STM32 USART1 TX (PA9).

    config GATEWAY_CONSOLE_ENABLE
        bool "Enable local M7 upgrade console"
        default y
        help
            Register the 'firmware' and 'upgrade' commands on the ESP-IDF
            primary console. Upgrade execution still requires an explicit
            'upgrade start' command and never starts automatically at boot.

    config GATEWAY_WIFI_SSID
        string "Fallback Wi-Fi station SSID"
        default ""
        help
            Optional compile-time fallback. The recommended path is the
            runtime 'wifi configure' console command, which stores a profile
            in NVS. Do not commit real credentials to sdkconfig.defaults.

    config GATEWAY_WIFI_PASSWORD
        string "Fallback Wi-Fi station password"
        default ""
        help
            Optional compile-time fallback used only when NVS has no runtime
            network profile.

    config GATEWAY_FIRMWARE_SERVER_URL
        string "Fallback M8 firmware server base URL"
        default ""
        help
            Optional compile-time fallback used only when NVS has no runtime
            network profile. 127.0.0.1 refers to the ESP32 itself.

    config GATEWAY_WIFI_CONNECT_TIMEOUT_MS
        int "Wi-Fi connection wait timeout (ms)"
        range 1000 120000
        default 15000

    config GATEWAY_FIRMWARE_HTTP_TIMEOUT_MS
        int "M10 HTTP/HTTPS request timeout (ms)"
        range 1000 120000
        default 15000

    config GATEWAY_SNTP_SERVER
        string "M10 SNTP server used before certificate validation"
        default "pool.ntp.org"
        help
            ESP32 has no trusted wall clock after a cold boot. HTTPS downloads
            wait for SNTP before validating certificate validity dates.

    config GATEWAY_TIME_SYNC_TIMEOUT_MS
        int "M10 wall-clock synchronization timeout (ms)"
        range 1000 120000
        default 20000

    config GATEWAY_ALLOW_INSECURE_HTTP
        bool "Allow insecure HTTP firmware downloads"
        default n
        help
            Development compatibility switch. Keep this disabled for M10
            acceptance and production-like builds so firmware metadata and
            binaries are only fetched over authenticated HTTPS.

    config GATEWAY_RELIABILITY_TEST
        bool "Enable destructive M7 reliability fault injection"
        default n
        help
            Build test-only, one-shot fault injection hooks and register the
            'test fault' console command. Keep this disabled in production
            firmware. Reliability tests repeatedly erase the STM32 APP area.

endmenu
```
